## buildroot/audit/package/training-forwarder/Config.in
```kconfig
config BR2_PACKAGE_TRAINING_FORWARDER
        bool "Training forwarder"
        help
          Training forwarder
```

## buildroot/common/package/libexnl/Config.in
```kconfig
config BR2_PACKAGE_LIBEXNL
        bool "libexnl"
        help
          Simple library for handling the MLE netlink channel
```

## buildroot/common/package/mle-player/Config.in
```kconfig
config BR2_PACKAGE_MLE_PLAYER
        bool "MLE player"
        depends on BR2_INSTALL_LIBSTDCPP
        select BR2_PACKAGE_TENSORFLOW_LITE
        select BR2_PACKAGE_XTENSOR
        select BR2_PACKAGE_LIBEXNL
        help
          Exein MLE player

comment "MLE player needs a toolchain w/ C++"
	depends on !BR2_INSTALL_LIBSTDCPP
```

## buildroot/common/package/xtensor/Config.in
```kconfig
config BR2_PACKAGE_XTENSOR
	bool "xtensor"
	depends on BR2_INSTALL_LIBSTDCPP
	select BR2_PACKAGE_XTL
	help
	  Multi-dimensional arrays with broadcasting and lazy computing

comment "XTensor needs a toolchain w/ C++"
	depends on !BR2_INSTALL_LIBSTDCPP
```

## buildroot/common/package/xtl/Config.in
```kconfig
config BR2_PACKAGE_XTL
	bool "xtl"
	depends on BR2_INSTALL_LIBSTDCPP
	help
	  Basic tools (containers, algorithms) used by other quantstack packages

comment "XTL needs a toolchain w/ C++"
	depends on !BR2_INSTALL_LIBSTDCPP
```

## buildroot/release/package/mle-player-model/Config.in
```kconfig
config BR2_PACKAGE_MLE_PLAYER_MODEL
        bool "MLE player model"
        help
          Exein MLE player model
```

## yocto/meta-exein/conf/layer.conf
```bitbake
# We have a conf and classes directory, add to BBPATH
BBPATH .= ":${LAYERDIR}"

# We have recipes-* directories, add to BBFILES
BBFILES += "${LAYERDIR}/recipes-*/*/*.bb \
            ${LAYERDIR}/recipes-*/*/*.bbappend"

BBFILE_COLLECTIONS += "meta-exein"
BBFILE_PATTERN_meta-exein = "^${LAYERDIR}/"
BBFILE_PRIORITY_meta-exein = "6"

LAYERSERIES_COMPAT_meta-exein = "thud warrior zeus dunfell"

PREFERRED_PROVIDER_virtual/kernel ?= "linux-yocto"
PREFERRED_VERSION_linux-yocto ?= "5.%"
```
